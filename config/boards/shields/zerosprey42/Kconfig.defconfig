## config/boards/shields/zerosprey42/Kconfig.defconfig
```kconfig
# Copyright (c) 2020 The ZMK Contributors
# and (c) 2022 tubbytwins (Matthew A. Schnoor) and beekeeb
# SPDX-License-Identifier: MIT

if SHIELD_ZEROSPREY42

config ZMK_KEYBOARD_NAME
    default "Zerosprey42"

endif
```

## config/boards/shields/zerosprey42/Kconfig.shield
```kconfig
# Copyright (c) 2020 The ZMK Contributors
# and (c) 2022 tubbytwins (Matthew A. Schnoor) and beekeeb
# SPDX-License-Identifier: MIT

config SHIELD_ZEROSPREY42
    def_bool $(shields_list_contains,zerosprey42)
```

## config/west.yml
```yaml
manifest:
  remotes:
    - name: zmkfirmware
      url-base: https://github.com/zmkfirmware
    - name: glebsexy
      url-base: https://github.com/glebsexy
  projects:
    - name: zmk
      remote: glebsexy
      revision: rp2040-zero-plus-combos-fix
      import: app/west.yml
  self:
    path: config
```
